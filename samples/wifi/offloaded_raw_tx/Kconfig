## samples/wifi/offloaded_raw_tx/Kconfig
```kconfig
#
# Copyright (c) 2023 Nordic Semiconductor
#
# SPDX-License-Identifier: LicenseRef-Nordic-5-Clause
#

source "Kconfig.zephyr"

menu "Offloaded Raw TX sample"

config GENERATE_MAC_ADDRESS
	bool "Random Wi-Fi MAC address"
	depends on ENTROPY_GENERATOR
	help
		MAC address to be used by the sample. This is only used
		when the nRF7002 OTP is not programmed with a MAC address.

config BEACON_INTERVAL
	int "Beacon interval in milliseconds"
	default 100
	range 20 10000
	help
		Time interval (in ms) between beacon transmissions.
endmenu
```
