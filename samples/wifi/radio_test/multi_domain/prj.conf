## CMakeLists.txt
```
#
# Copyright (c) 2022 Nordic Semiconductor ASA
#
# SPDX-License-Identifier: LicenseRef-Nordic-5-Clause
#

cmake_minimum_required(VERSION 3.20.0)

find_package(Zephyr REQUIRED HINTS $ENV{ZEPHYR_BASE})
project(nrf_wifi_radio_test)

set(COMMON_RT_DIR ${CMAKE_CURRENT_SOURCE_DIR}/../common)
target_include_directories(app PRIVATE ${COMMON_RT_DIR}/inc)

target_sources(app PRIVATE
  src/nrf_wifi_radio_test_main.c
  ${COMMON_RT_DIR}/src/nrf_wifi_radio_test_shell.c
  ${COMMON_RT_DIR}/src/nrf_wifi_radio_ficr_shell.c
  ${COMMON_RT_DIR}/src/ficr_prog.c
)

target_link_libraries(app PRIVATE nrf-wifi-osal)
```

## prj.conf
```kconfig
#
# Copyright (c) 2022 Nordic Semiconductor ASA
#
# SPDX-License-Identifier: LicenseRef-Nordic-5-Clause
#
CONFIG_WIFI=y
CONFIG_WIFI_NRF70=y
CONFIG_NRF70_RADIO_TEST=y

CONFIG_NRF70_SR_COEX=y

#CONFIG_INIT_STACKS=y

# Memories
CONFIG_MAIN_STACK_SIZE=5200
CONFIG_SHELL_STACK_SIZE=5200
#64K memory needed for IQ sample captures.
CONFIG_NRF_WIFI_CTRL_HEAP_SIZE=78304
#ADC capture max: 16383*3=49KB, 64KB provides headroom
CONFIG_HEAP_MEM_POOL_SIZE=65536

# Debugging
CONFIG_STACK_SENTINEL=y
CONFIG_DEBUG_COREDUMP=y
CONFIG_DEBUG_COREDUMP_BACKEND_LOGGING=y
CONFIG_DEBUG_COREDUMP_MEMORY_DUMP_MIN=y
CONFIG_SHELL_CMDS_RESIZE=n
#CONFIG_DEBUG=y

# Logging
CONFIG_LOG=y
CONFIG_PRINTK=y
CONFIG_SHELL=y
CONFIG_SHELL_GETOPT=y
CONFIG_DEVICE_SHELL=y
CONFIG_POSIX_TIMERS=y
CONFIG_DATE_SHELL=y
CONFIG_LOG_BUFFER_SIZE=4096
CONFIG_SHELL_BACKEND_SERIAL_RX_RING_BUFFER_SIZE=1024
```

## inc/nrf_wifi_radio_test_shell.h
```c
/*
 * Copyright (c) 2022 Nordic Semiconductor ASA
 *
 * SPDX-License-Identifier: LicenseRef-Nordic-5-Clause
 */

/* @file
 * @brief nRF Wi-Fi radio-test mode shell module
 */

#include <zephyr/kernel.h>
#include <stdio.h>
#include <stdlib.h>
#include <zephyr/shell/shell.h>
#include <zephyr/init.h>
#include <ctype.h>
#ifndef CONFIG_NRF71_ON_IPC
#include <host_rpu_sys_if.h>
#else
#include <nrf71_wifi_rf.h>
#include <nrf71_wifi_common.h>
#endif /* CONFIG_NRF71_ON_IPC */
#include <radio_test/fmac_structs.h>
#include <zephyr/drivers/wifi/nrf_wifi/bus/rpu_hw_if.h>
#include <zephyr/net/wifi.h>

/* RX capture display constants */
#define SAMPLES_PER_LINE 16
#define BYTES_PER_SAMPLE 3
#define BYTES_PER_LINE 48

struct nrf_wifi_ctx_zep_rt {
	struct nrf_wifi_fmac_priv *fmac_priv;
	struct rpu_conf_params conf_params;
};
```
